## boards/iot/iot_i832_tba/Kconfig.defconfig
```kconfig
# EBYTE E73-TBB NRF52832 board configuration

# Copyright (c) 2016 Nordic Semiconductor ASA
# Copyright (c) 2021 Michal Morsisko
# SPDX-License-Identifier: Apache-2.0

if BOARD_IOT_I832_TBA_NRF52832

config BT_CTLR
	default BT

endif # BOARD_IOT_I832_TBA_NRF52832
```

## boards/iot/iot_i832_tba/Kconfig.iot_i832_tba
```kconfig
# EBYTE-TBB board configuration

# Copyright (c) 2021 Michal Morsisko
# SPDX-License-Identifier: Apache-2.0

config BOARD_IOT_I832_TBA_NRF52832
	select SOC_NRF52832_QFAA
```

## build/Kconfig/Kconfig.shield
```kconfig
osource "e:/project/ble_boards/boards/shields/*/Kconfig.shield"
osource "e:/project/innovation/bluetoothmotiondt/ble/applications/vibtrack/boards/shields/*/Kconfig.shield"
osource "c:/my_boards/boards/shields/*/Kconfig.shield"
osource "C:/ncs/v2.7.0/nrf/boards/shields/*/Kconfig.shield"
```

## build/Kconfig/Kconfig.shield.defconfig
```kconfig
osource "e:/project/ble_boards/boards/shields/*/Kconfig.defconfig"
osource "e:/project/innovation/bluetoothmotiondt/ble/applications/vibtrack/boards/shields/*/Kconfig.defconfig"
osource "c:/my_boards/boards/shields/*/Kconfig.defconfig"
osource "C:/ncs/v2.7.0/nrf/boards/shields/*/Kconfig.defconfig"
```
